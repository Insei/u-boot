## board/nvidia/mocha/Kconfig
```kconfig
if TARGET_MOCHA

config SYS_CPU
	string
	default "arm720t" if SPL_BUILD
	default "armv7" if !SPL_BUILD

config SYS_BOARD
	string
	default "mocha"

config SYS_VENDOR
	string
	default "nvidia"

config SYS_SOC
	string
	default "tegra124"

config SYS_CONFIG_NAME
	string
	default "mocha"

endif
```
